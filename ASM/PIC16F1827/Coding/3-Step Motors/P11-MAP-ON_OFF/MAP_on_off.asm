	; ING. ROBERTO ISAAC SUASTE MARTINEZ
	


	#INCLUDE <P16F1827.INC> 					;DECLARO LA LIBRERIA DEL MICROCONTROLADOR CORRESPONDIENTE


	__config	_CONFIG1, _FOSC_INTOSC & _WDTE_OFF & _PWRTE_ON & _MCLRE_OFF & _CP_OFF & _CPD_OFF & _BOREN_ON & _CLKOUTEN_OFF & _IESO_OFF & _FCMEN_OFF
	__config	_CONFIG2, _WRT_OFF & _PLLEN_ON & _STVREN_ON & _LVP_OFF 
	

	ERRORLEVEL  -302            				; ELIMINO DE LA VENTANA DE COMPILACION EL ERROR 302

	CBLOCK	0X120							;DECLARO LOS REGISTROS DE PROPOSITO GENERAL A USAR (VARIABLES)
	NUM1,NUM2,NUM3
	ENDC

   #DEFINE B_ARRANQUE     PORTA,0
   #DEFINE B_PARO         PORTA,1
 


   #DEFINE ROJO     LATB,0
   #DEFINE CAFE     LATB,1
   #DEFINE AMARILLO LATB,2
   #DEFINE NARANJA  LATB,3




	ORG	0X00
	GOTO INICIO						;DECLARO EL VECTOR DE INICIO O RESET

	ORG	0X04	
	RETFIE							; DECLARO EL VECTOR DE INTERRUPCION

INICIO:		
					BANKSEL	OSCCON		
				MOVLW		B'11110000'	;CONFIGURO EL REGISTRO OSCCON
				MOVWF		OSCCON


					BANKSEL	APFCON0
				MOVLW		B'01111111'		;CONFIGURO LOS REGISTROS	APFCON0 Y APFCON1
				MOVWF		APFCON0
			
					BANKSEL	APFCON1
				MOVLW		B'00000000'
				MOVWF		APFCON1
		
					BANKSEL ANSELB
				CLRF ANSELB 				;DESHABILITO LOS CANALES ANALOGICOS
				CLRF ANSELA 

					BANKSEL	TRISB	
			    CLRF TRISB		;CONFIGURO TRISB COMO SALIDA PARA LAS BOBINAS
				
				MOVLW B'11111111'
				MOVWF TRISA     ;CONFIGURO TRISA COMO ENTRADA PARA MIS BOTONES

					BANKSEL LATB
                CLRF LATB       ;ELIMINO POSIBLE BASURA EN EL PUERTO B
					

PROGRAMA
				   BANKSEL PORTA
                   BTFSS B_ARRANQUE
				   GOTO PROGRAMA
                   GOTO SECUENCIA

SECUENCIA
				   BANKSEL LATB

				   BSF 	AMARILLO
				   CALL RETARDO_15MS
				   BCF AMARILLO
				   CALL RETARDO_15MS
						
				   BSF  CAFE
				   CALL RETARDO_15MS
				   BCF  CAFE
				   CALL RETARDO_15MS

				   BSF 	ROJO
				   CALL RETARDO_15MS
				   BCF  ROJO
				   CALL RETARDO_15MS
 
				   BSF 	NARANJA
				   CALL RETARDO_15MS
				   BCF  NARANJA
				   CALL RETARDO_15MS
			
 				
					BANKSEL PORTA
					BTFSS B_PARO
					GOTO SECUENCIA
					GOTO APAGO_MOTOR

APAGO_MOTOR
					BANKSEL LATB
					CLRF	LATB			;APAGO MOTOR
                   
				    GOTO PROGRAMA           ;REGRESO AL PROGRAMA PRINCIPAL
					
				
				; S U B R U T I N A  D E   R E T A R D O

RETARDO_15MS
			MOVLW	.15 	
			MOVWF	NUM3

OTRA1:		MOVLW	.7
			MOVWF	NUM2

OTRA:		MOVLW	.46
			MOVWF	NUM1
			DECFSZ	NUM1,F
			GOTO	$-1
			DECFSZ	NUM2
			GOTO	OTRA

			
			DECFSZ	NUM3
			GOTO	OTRA1
			RETURN


END 		;D I R E C T R I Z   D E   F I N A L   D E   P R O G R A M A